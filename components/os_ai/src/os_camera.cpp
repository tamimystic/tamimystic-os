#include "os_camera.h"
#include "os_hal_uart.h"
#include "os_pin_matrix.h"
#include <chrono>

#ifndef OS_TARGET_NATIVE
#if __has_include("esp_camera.h")
#define HAVE_ESP_CAMERA 1
#include "esp_camera.h"
#else
#define HAVE_ESP_CAMERA 0
#endif
#endif

namespace TamimysticOS {

// Standard minimal valid 320x240 JPEG baseline bitstream header & image template
static const uint8_t minimal_jpeg_template[] = {
    0xFF, 0xD8, 0xFF, 0xE0, 0x00, 0x10, 'J',  'F',  'I',  'F',  0x00, 0x01, 0x01, 0x01, 0x00, 0x48,
    0x00, 0x48, 0x00, 0x00, 0xFF, 0xDB, 0x00, 0x43, 0x00, 0x08, 0x06, 0x06, 0x07, 0x06, 0x05, 0x08,
    0x07, 0x07, 0x07, 0x09, 0x09, 0x08, 0x0A, 0x0C, 0x14, 0x0D, 0x0C, 0x0B, 0x0B, 0x0C, 0x19, 0x12,
    0x13, 0x0F, 0x14, 0x1D, 0x1A, 0x1F, 0x1E, 0x1D, 0x1A, 0x1C, 0x1C, 0x20, 0x24, 0x2E, 0x27, 0x20,
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    0x00, 0x08, 0x01, 0x01, 0x00, 0x00, 0x3F, 0x00, 0x7F, 0xFF, 0xD9
};

CameraManager& CameraManager::getInstance() {
    static CameraManager instance;
    return instance;
}

bool CameraManager::init(FrameResolution resolution, FrameFormat format) {
    current_resolution = resolution;
    current_format = format;

#if defined(OS_TARGET_NATIVE) || (defined(HAVE_ESP_CAMERA) && HAVE_ESP_CAMERA == 0)
    hal_uart_print("[CAMERA] Initializing Simulated Camera Frame Generator (320x240 JPEG)...\n");
    generateNativeMockFrame();
    initialized = true;
    hal_uart_print("[CAMERA] Camera Simulation Ready (Octal PSRAM Emulation Active).\n");
    return true;
#else
    hal_uart_print("[CAMERA] Initializing ESP32-S3 DVP Camera Driver with 8MB Octal PSRAM...\n");
    camera_config_t config;
    config.ledc_channel = LEDC_CHANNEL_0;
    config.ledc_timer = LEDC_TIMER_0;
    config.pin_d0 = 11;
    config.pin_d1 = 9;
    config.pin_d2 = 8;
    config.pin_d3 = 10;
    config.pin_d4 = 12;
    config.pin_d5 = 18;
    config.pin_d6 = 17;
    config.pin_d7 = 16;
    config.pin_xclk = 15;
    config.pin_pclk = 13;
    config.pin_vsync = 6;
    config.pin_href = 7;
    config.pin_sccb_sda = 4;
    config.pin_sccb_scl = 5;
    config.pin_pwdn = -1;
    config.pin_reset = -1;
    config.xclk_freq_hz = 20000000;
    config.pixel_format = PIXFORMAT_JPEG;
    config.frame_size = FRAMESIZE_QVGA;
    config.jpeg_quality = 12;
    config.fb_count = 2;
    config.fb_location = CAMERA_FB_IN_PSRAM;
    config.grab_mode = CAMERA_GRAB_LATEST;

    esp_err_t err = esp_camera_init(&config);
    if (err != ESP_OK) {
        hal_uart_print(("[CAMERA] Warning: Physical camera not detected (code " + std::to_string(err) + "). Falling back to simulated stream.\n").c_str());
        generateNativeMockFrame();
        initialized = true;
        return true;
    }
    initialized = true;
    hal_uart_print("[CAMERA] ESP32-S3 Hardware Camera Pipeline Initialized in PSRAM.\n");
    return true;
#endif
}

void CameraManager::generateNativeMockFrame() {
    mock_jpeg_buffer.assign(std::begin(minimal_jpeg_template), std::end(minimal_jpeg_template));
    
    int w = 320, h = 240;
    getResolutionDimensions(current_resolution, w, h);

    native_frame.buf = mock_jpeg_buffer.data();
    native_frame.len = mock_jpeg_buffer.size();
    native_frame.width = w;
    native_frame.height = h;
    native_frame.format = current_format;
    native_frame.timestamp_ms = (uint32_t)frame_counter++;
}

CameraFrame* CameraManager::getFrame() {
    if (!initialized) return nullptr;

#if defined(OS_TARGET_NATIVE) || (defined(HAVE_ESP_CAMERA) && HAVE_ESP_CAMERA == 0)
    generateNativeMockFrame();
    return &native_frame;
#else
    camera_fb_t* fb = esp_camera_fb_get();
    if (!fb) {
        generateNativeMockFrame();
        return &native_frame;
    }
    
    CameraFrame* frame = new CameraFrame();
    frame->buf = fb->buf;
    frame->len = fb->len;
    frame->width = fb->width;
    frame->height = fb->height;
    frame->format = current_format;
    return frame;
#endif
}

void CameraManager::returnFrame(CameraFrame* frame) {
    if (!frame) return;

#if !defined(OS_TARGET_NATIVE) && defined(HAVE_ESP_CAMERA) && (HAVE_ESP_CAMERA == 1)
    if (frame != &native_frame) {
        delete frame;
    }
#endif
}

bool CameraManager::isInitialized() const {
    return initialized;
}

FrameResolution CameraManager::getResolution() const {
    return current_resolution;
}

FrameFormat CameraManager::getFormat() const {
    return current_format;
}

} // namespace TamimysticOS
